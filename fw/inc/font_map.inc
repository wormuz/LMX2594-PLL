{0x0020,0},{0x0021,1},{0x0022,2},{0x0023,3},{0x0024,4},{0x0025,5},{0x0026,6},{0x0027,7},{0x0028,8},{0x0029,9},{0x002A,10},{0x002B,11},{0x002C,12},{0x002D,13},{0x002E,14},{0x002F,15},{0x0030,16},{0x0031,17},{0x0032,18},{0x0033,19},{0x0034,20},{0x0035,21},{0x0036,22},{0x0037,23},{0x0038,24},{0x0039,25},{0x003A,26},{0x003B,27},{0x003C,28},{0x003D,29},{0x003E,30},{0x003F,31},{0x0040,32},{0x0041,33},{0x0042,34},{0x0043,35},{0x0044,36},{0x0045,37},{0x0046,38},{0x0047,39},{0x0048,40},{0x0049,41},{0x004A,42},{0x004B,43},{0x004C,44},{0x004D,45},{0x004E,46},{0x004F,47},{0x0050,48},{0x0051,49},{0x0052,50},{0x0053,51},{0x0054,52},{0x0055,53},{0x0056,54},{0x0057,55},{0x0058,56},{0x0059,57},{0x005A,58},{0x005B,59},{0x005C,60},{0x005D,61},{0x005E,62},{0x005F,63},{0x0060,64},{0x0061,65},{0x0062,66},{0x0063,67},{0x0064,68},{0x0065,69},{0x0066,70},{0x0067,71},{0x0068,72},{0x0069,73},{0x006A,74},{0x006B,75},{0x006C,76},{0x006D,77},{0x006E,78},{0x006F,79},{0x0070,80},{0x0071,81},{0x0072,82},{0x0073,83},{0x0074,84},{0x0075,85},{0x0076,86},{0x0077,87},{0x0078,88},{0x0079,89},{0x007A,90},{0x007B,91},{0x007C,92},{0x007D,93},{0x007E,94},{0x0410,95},{0x0411,96},{0x0412,97},{0x0413,98},{0x0490,99},{0x0414,100},{0x0415,101},{0x0404,102},{0x0416,103},{0x0417,104},{0x0418,105},{0x0406,106},{0x0407,107},{0x0419,108},{0x041A,109},{0x041B,110},{0x041C,111},{0x041D,112},{0x041E,113},{0x041F,114},{0x0420,115},{0x0421,116},{0x0422,117},{0x0423,118},{0x0424,119},{0x0425,120},{0x0426,121},{0x0427,122},{0x0428,123},{0x0429,124},{0x042C,125},{0x042E,126},{0x042F,127},{0x0430,128},{0x0431,129},{0x0432,130},{0x0433,131},{0x0491,132},{0x0434,133},{0x0435,134},{0x0454,135},{0x0436,136},{0x0437,137},{0x0438,138},{0x0456,139},{0x0457,140},{0x0439,141},{0x043A,142},{0x043B,143},{0x043C,144},{0x043D,145},{0x043E,146},{0x043F,147},{0x0440,148},{0x0441,149},{0x0442,150},{0x0443,151},{0x0444,152},{0x0445,153},{0x0446,154},{0x0447,155},{0x0448,156},{0x0449,157},{0x044C,158},{0x044E,159},{0x044F,160}
